## board/trucrux/imx8mp_trux/Kconfig
```kconfig
if TARGET_IMX8MP_TRUX

config SYS_BOARD
	default "imx8mp_trux"

config SYS_VENDOR
	default "trucrux"

config SYS_CONFIG_NAME
	default "imx8mp_trux"

source "board/freescale/common/Kconfig"

endif
```
